## config/west.yml
```yaml
manifest:
  defaults:
    revision: v0.3
  remotes:
    - name: zmkfirmware
      url-base: https://github.com/zmkfirmware
    - name: joelspadin
      url-base: https://github.com/joelspadin
    - name: mctechnology17
      url-base: https://github.com/mctechnology17
  projects:
    - name: zmk
      remote: zmkfirmware
      import: app/west.yml
    - name: zmk-locales
      remote: joelspadin
      revision: be0427eaa80c7bb9a3d74ab11a78d53b98f5c5aa
    - name: zmk-nice-oled
      remote: mctechnology17
      revision: 46f824abb2bd41f1287c5c68abd14122af6042a3
  self:
    path: config
```
